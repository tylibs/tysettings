## CMakeLists.txt
```
# SPDX-FileCopyrightText: Copyright 2025 Clever Design (Switzerland) GmbH
# SPDX-License-Identifier: Apache-2.0
cmake_minimum_required(VERSION 3.20.0)

list(APPEND EXTRA_ZEPHYR_MODULES ${CMAKE_CURRENT_SOURCE_DIR}/../../../
     ${CMAKE_CURRENT_SOURCE_DIR}/../../../../typlatform)

find_package(Zephyr REQUIRED HINTS $ENV{ZEPHYR_BASE})

project(hello_world)
target_link_libraries(app PRIVATE tysettings)
# Application Files
add_subdirectory(src)
```

## prj.conf
```kconfig
CONFIG_TYSETTINGS=y
CONFIG_TY_LOG=y
CONFIG_TY_LOG_LEVEL_INFO=y

#*****************************************************************************/
#*                                Logging                                    */
#*****************************************************************************/
CONFIG_LOG=y
CONFIG_LOG_DEFAULT_LEVEL=3
```

## src/main.cpp
```c
// SPDX-FileCopyrightText: Copyright 2025 Clever Design (Switzerland) GmbH
// SPDX-License-Identifier: Apache-2.0

/**
 * @file
 * @brief
 *   TySettings simplest example: Hello World
 */

#include <ty/logging.h>
#include <ty/platform/toolchain.h>
#include <zephyr/kernel.h>
#include "tysettings/platform/settings.h"

static const char *kLogModule = "HelloWorld";

/*****************************************************************************/
// just as a hint, but better not to pack, because this object only lives once
TY_TOOL_PACKED_BEGIN
struct AppPersistentSettings
{
    int a;
    int b;
} TY_TOOL_PACKED_END;

// keep the settings in global scope but not accessible (in C this would be static)
// the Settings will be injected in each module to support testing setups
namespace {
AppPersistentSettings mAppPersistentSettings = {1, 2};
}

extern "C" int main(void)
{
    tinyInstance *instance;
    tyLogInfo(kLogModule, "Starting TySettings example");

    instance = tinyInstanceInitSingle();
    // Initialize the settings subsystem
    tyPlatSettingsInit(instance, NULL, 0);
    tyPlatSettingsSet(instance, 1, (uint8_t *)&mAppPersistentSettings, sizeof(mAppPersistentSettings));
    while (true)
    {
        // next event in 1 second
        k_sleep(K_SECONDS(1));
    }
    tinyInstanceFinalize(instance);
    return 0;
}
```
